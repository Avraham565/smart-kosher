## experiments/zigbee_probe/h2_coordinator_firmware/main/Kconfig.projbuild
```kconfig
menu "Smart Kosher H2 Coordinator"

    config COORD_FW_NAME
        string "Firmware name reported over the link"
        default "smart_kosher_h2_coordinator"

    config COORD_FW_VERSION
        string "Firmware version reported over the link"
        default "0.11.2"
        help
            0.8.0 first proved delivery: on_off is acked only once the
            device's own radio confirms the frame, so the hub can tell
            "sent" from "arrived".

            0.9.0 applies the same rule to reporting. Configuring reporting
            now succeeds only when the DEVICE says it accepted the values,
            not when our request reached it -- and read_report_cfg asks a
            device what interval it is actually running, because asking for
            min_interval = 0 and getting a report every 3 seconds were both
            true at once. See docs/h2_production_plan.md.

    config COORD_MAX_CHILDREN
        int "Max devices that may join the coordinator directly"
        default 10
        range 1 200
        help
            Direct children only -- NOT a cap on the network. Mains-powered
            switches are routers and host children of their own, so device
            11 can still join through device 3.

            But in a home where every switch is in range of the panel, they
            all try the coordinator first, and once this is full a join
            depends on some existing router accepting the device. That is a
            real pairing failure mode.

            10 is inherited from Espressif's coordinator example, not derived
            from anything. The field is a uint8_t so the API allows far more,
            but the true ceiling is the stack's internal neighbour table,
            which this SDK does not expose -- raising this must be verified on
            hardware (does it still form a network, and can 11+ devices join
            directly?). Left at the proven value until then.

    config COORD_UART_PORT
        int "UART port used for S3 slot communication"
        default 1

    config COORD_UART_TXD_PIN
        int "UART TX GPIO"
        default 24
        help
            Per-target value comes from sdkconfig.defaults.<target>.
            esp32h2 (CrowPanel slot): GPIO24 -> S3 GPIO19.
            esp32c6 (NanoC6 Grove):   GPIO1 (white) -> AtomS3 G1.

    config COORD_UART_RXD_PIN
        int "UART RX GPIO"
        default 2
        help
            Per-target value comes from sdkconfig.defaults.<target>.
            esp32h2 (CrowPanel slot): S3 GPIO5 -> GPIO2.
            esp32c6 (NanoC6 Grove):   AtomS3 G2 (yellow) -> GPIO2.

    config COORD_UART_BAUD_RATE
        int "UART baud rate"
        default 115200

    config COORD_BOOT_BEACON_COUNT
        int "Boot beacon repeat count"
        default 10

endmenu
```

## firmware/h2_coordinator/main/Kconfig.projbuild
```kconfig
menu "Smart Kosher H2 Coordinator"

    config COORD_FW_NAME
        string "Firmware name reported over the link"
        default "smart_kosher_h2_coordinator"

    config COORD_FW_VERSION
        string "Firmware version reported over the link"
        default "0.12.0"
        help
            0.8.0 first proved delivery: on_off is acked only once the
            device's own radio confirms the frame, so the hub can tell
            "sent" from "arrived".

            0.9.0 applies the same rule to reporting. Configuring reporting
            now succeeds only when the DEVICE says it accepted the values,
            not when our request reached it -- and read_report_cfg asks a
            device what interval it is actually running, because asking for
            min_interval = 0 and getting a report every 3 seconds were both
            true at once. See docs/h2_production_plan.md.

            0.10.0 adds cluster discovery: ZDO Simple_Desc after a join
            reports what each endpoint actually carries, so "does this relay
            measure power?" is answered by the device instead of by its model
            number.

            0.11.x added electrical measurement reporting (0x0702 metering,
            0x0B04 electrical measurement) alongside OnOff. It never worked --
            both clusters answered configure_send_failed, two hypotheses were
            tried and neither fixed it.

            0.12.0 REMOVES electrical measurement entirely (product decision,
            2026-08-05): the reportable-attribute table, the value decoding,
            the measurement_report event, and the measurement cluster
            descriptors on our own endpoint are all gone. Cluster DISCOVERY
            stays -- it answers "what can this device do", which is what
            multi-gang support needs, and has nothing to do with measuring.

            A useful side effect: reporting is now only ever configured for
            OnOff, so a device can never have two configure transactions open
            at once. The ambiguity in matching their responses -- which could
            report a metering failure as an OnOff failure and knock a healthy
            device out of reporting -- is gone by construction.

    config COORD_MAX_CHILDREN
        int "Max devices that may join the coordinator directly"
        default 10
        range 1 200
        help
            Direct children only -- NOT a cap on the network. Mains-powered
            switches are routers and host children of their own, so device
            11 can still join through device 3.

            But in a home where every switch is in range of the panel, they
            all try the coordinator first, and once this is full a join
            depends on some existing router accepting the device. That is a
            real pairing failure mode.

            10 is inherited from Espressif's coordinator example, not derived
            from anything. The field is a uint8_t so the API allows far more,
            but the true ceiling is the stack's internal neighbour table,
            which this SDK does not expose -- raising this must be verified on
            hardware (does it still form a network, and can 11+ devices join
            directly?). Left at the proven value until then.

    config COORD_UART_PORT
        int "UART port used for S3 slot communication"
        default 1

    config COORD_UART_TXD_PIN
        int "UART TX GPIO"
        default 24
        help
            Per-target value comes from sdkconfig.defaults.<target>.
            esp32h2 (CrowPanel slot): GPIO24 -> S3 GPIO19.
            esp32c6 (NanoC6 Grove):   GPIO1 (white) -> AtomS3 G1.

    config COORD_UART_RXD_PIN
        int "UART RX GPIO"
        default 2
        help
            Per-target value comes from sdkconfig.defaults.<target>.
            esp32h2 (CrowPanel slot): S3 GPIO5 -> GPIO2.
            esp32c6 (NanoC6 Grove):   AtomS3 G2 (yellow) -> GPIO2.

    config COORD_UART_BAUD_RATE
        int "UART baud rate"
        default 115200

    config COORD_BOOT_BEACON_COUNT
        int "Boot beacon repeat count"
        default 10

endmenu
```
